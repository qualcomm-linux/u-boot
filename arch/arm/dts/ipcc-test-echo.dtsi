// SPDX-License-Identifier: BSD-3-Clause
/*
 * Copyright (c) Qualcomm Technologies, Inc. and/or its subsidiaries.
 */

#include <dt-bindings/mailbox/qcom-ipcc-echo.h>

&soc {
	ipcc_self_ping_apss: ipcc-self-ping-apss {
		compatible = "qcom,ipcc-self-ping";
		interrupts-extended = <&ipcc_mproc IPCC_MPROC_APSS
			IPCC_MPROC_SIGNAL_SMP2P IRQ_TYPE_LEVEL_HIGH>;
		mboxes = <&ipcc_mproc IPCC_MPROC_APSS IPCC_MPROC_SIGNAL_SMP2P>;
	};

	ipcc_self_ping_cdsp: ipcc-self-ping-cdsp {
		compatible = "qcom,ipcc-self-ping";
		interrupts-extended = <&ipcc_mproc IPCC_MPROC_CDSP
				IPCC_MPROC_SIGNAL_PING IRQ_TYPE_LEVEL_HIGH>;
		mboxes = <&ipcc_mproc IPCC_MPROC_CDSP IPCC_MPROC_SIGNAL_PING>;
	};
};
