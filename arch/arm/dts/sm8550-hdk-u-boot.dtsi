// SPDX-License-Identifier: BSD-3-Clause
/*
 * Copyright (c) 2026, IMD Technologies Ltd. All rights reserved.
 */
/ {
	/delete-node/ memory@a0000000;

	memory@81200000 {
		device_type = "memory";
		reg = <0x0 0x81200000 0x0 0x00800000>,
		      <0x0 0x81cf4000 0x0 0x0000c000>,
		      <0x0 0x81f20000 0x0 0x006e0000>,
		      <0x0 0x86e00000 0x0 0x03a00000>,
		      <0x0 0x9b09c000 0x0 0x00064000>,
		      <0x0 0xa2a80000 0x0 0x32000000>,
		      <0x8 0x88000000 0x0 0x39a00000>,
		      <0x8 0x8c000000 0x0 0xd8000000>;
	};
};
