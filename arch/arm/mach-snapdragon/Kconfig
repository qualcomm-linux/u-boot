## drivers/pinctrl/qcom/Kconfig
```kconfig
if ARCH_SNAPDRAGON || ARCH_IPQ40XX

config PINCTRL_QCOM
	depends on PINCTRL_GENERIC
	def_bool n

config SPL_PINCTRL_QCOM
	depends on SPL_PINCTRL_GENERIC
	def_bool n

menu "Qualcomm pinctrl drivers"

config PINCTRL_QCOM_GENERIC
	bool "Enable all Qualcomm pinctrl drivers by default"
	select PINCTRL_QCOM
	help
	  Say Y here to enable all Qualcomm pinctrl drivers by default.
	  This is useful for generic Qualcomm defconfigs that support
	  multiple SoCs. Individual drivers can still be disabled if needed.

config SPL_PINCTRL_QCOM_GENERIC
	bool "Enable all Qualcomm pinctrl drivers in SPL by default"
	depends on SPL_PINCTRL_GENERIC
	select SPL_PINCTRL_QCOM
	help
	  SPL variant of PINCTRL_QCOM_GENERIC.
	  Say Y here to enable all Qualcomm pinctrl drivers in SPL by default.
	  This is useful for generic Qualcomm SPL defconfigs that support
	  multiple SoCs. Individual SPL drivers can still be disabled if needed.

config PINCTRL_QCOM_APQ8016
	bool "Qualcomm APQ8016 Pinctrl"
	default y if PINCTRL_QCOM_GENERIC
	select PINCTRL_QCOM
	help
	  Say Y here to enable support for pinctrl on the MSM8916 / APQ8016
	  Snapdragon 410 SoC, as well as the associated GPIO driver.

config SPL_PINCTRL_QCOM_APQ8016
	bool "Qualcomm APQ8016 Pinctrl in SPL"
	depends on SPL_PINCTRL_GENERIC
	select SPL_PINCTRL_QCOM
	help
	  SPL variant of PINCTRL_QCOM_APQ8016.
	  See the help of PINCTRL_QCOM_APQ8016 for details.

config PINCTRL_QCOM_APQ8096
	bool "Qualcomm APQ8096 Pinctrl"
	default y if PINCTRL_QCOM_GENERIC
	select PINCTRL_QCOM
	help
	  Say Y here to enable support for pinctrl on the MSM8996 / APQ8096
	  Snapdragon 820 SoC, as well as the associated GPIO driver.

config SPL_PINCTRL_QCOM_APQ8096
	bool "Qualcomm APQ8096 Pinctrl in SPL"
	depends on SPL_PINCTRL_GENERIC
	select SPL_PINCTRL_QCOM
	help
	  SPL variant of PINCTRL_QCOM_APQ8096.
	  See the help of PINCTRL_QCOM_APQ8096 for details.

config PINCTRL_QCOM_IPQ4019
	bool "Qualcomm IPQ4019 Pinctrl"
	default y if PINCTRL_QCOM_GENERIC
	select PINCTRL_QCOM
	help
	  Say Y here to enable support for pinctrl on the IPQ4019 SoC,
	  as well as the associated GPIO driver.

config SPL_PINCTRL_QCOM_IPQ4019
	bool "Qualcomm IPQ4019 Pinctrl in SPL"
	depends on SPL_PINCTRL_GENERIC
	select SPL_PINCTRL_QCOM
	help
	  SPL variant of PINCTRL_QCOM_IPQ4019.
	  See the help of PINCTRL_QCOM_IPQ4019 for details.

config PINCTRL_QCOM_IPQ5210
	bool "Qualcomm IPQ5210 Pinctrl"
	default y if PINCTRL_QCOM_GENERIC
	select PINCTRL_QCOM
	help
	  Say Y here to enable support for pinctrl on the IPQ5210 SoC,
	  as well as the associated GPIO driver.

config PINCTRL_QCOM_IPQ5424
	bool "Qualcomm IPQ5424 Pinctrl"
	default y if PINCTRL_QCOM_GENERIC
	select PINCTRL_QCOM
	help
	  Say Y here to enable support for pinctrl on the IPQ5424 SoC,
	  as well as the associated GPIO driver.

config SPL_PINCTRL_QCOM_IPQ5424
	bool "Qualcomm IPQ5424 Pinctrl in SPL"
	depends on SPL_PINCTRL_GENERIC
	select SPL_PINCTRL_QCOM
	help
	  SPL variant of PINCTRL_QCOM_IPQ5424.
	  See the help of PINCTRL_QCOM_IPQ5424 for details.

config PINCTRL_QCOM_IPQ9574
	bool "Qualcomm IPQ9574 Pinctrl"
	default y if PINCTRL_QCOM_GENERIC
	select PINCTRL_QCOM
	help
	  Say Y here to enable support for pinctrl on the IPQ9574 SoC,
	  as well as the associated GPIO driver.

config SPL_PINCTRL_QCOM_IPQ9574
	bool "Qualcomm IPQ9574 Pinctrl in SPL"
	depends on SPL_PINCTRL_GENERIC
	select SPL_PINCTRL_QCOM
	help
	  SPL variant of PINCTRL_QCOM_IPQ9574.
	  See the help of PINCTRL_QCOM_IPQ9574 for details.

config PINCTRL_QCOM_MILOS
	bool "Qualcomm Milos Pinctrl"
	default y if PINCTRL_QCOM_GENERIC
	select PINCTRL_QCOM
	help
	  Say Y here to enable support for pinctrl on the Snapdragon Milos SoC,
	  as well as the associated GPIO driver.

config SPL_PINCTRL_QCOM_MILOS
	bool "Qualcomm Milos Pinctrl in SPL"
	depends on SPL_PINCTRL_GENERIC
	select SPL_PINCTRL_QCOM
	help
	  SPL variant of PINCTRL_QCOM_MILOS.
	  See the help of PINCTRL_QCOM_MILOS for details.

config PINCTRL_QCOM_QCM2290
	bool "Qualcomm QCM2290 Pinctrl"
	default y if PINCTRL_QCOM_GENERIC
	select PINCTRL_QCOM
	help
	  Say Y here to enable support for pinctrl on the Snapdragon QCM2290 SoC,
	  as well as the associated GPIO driver.

config SPL_PINCTRL_QCOM_QCM2290
	bool "Qualcomm QCM2290 Pinctrl in SPL"
	depends on SPL_PINCTRL_GENERIC
	select SPL_PINCTRL_QCOM
	help
	  SPL variant of PINCTRL_QCOM_QCM2290.
	  See the help of PINCTRL_QCOM_QCM2290 for details.

config PINCTRL_QCOM_QCS404
	bool "Qualcomm QCS404 Pinctrl"
	default y if PINCTRL_QCOM_GENERIC
	select PINCTRL_QCOM
	help
	  Say Y here to enable support for pinctrl on the Snapdragon QCS404 SoC,
	  as well as the associated GPIO driver.

config SPL_PINCTRL_QCOM_QCS404
	bool "Qualcomm QCS404 Pinctrl in SPL"
	depends on SPL_PINCTRL_GENERIC
	select SPL_PINCTRL_QCOM
	help
	  SPL variant of PINCTRL_QCOM_QCS404.
	  See the help of PINCTRL_QCOM_QCS404 for details.

config PINCTRL_QCOM_QCS615
	bool "Qualcomm QCS615 Pinctrl"
	default y if PINCTRL_QCOM_GENERIC
	select PINCTRL_QCOM
	help
	  Say Y here to enable support for pinctrl on the Snapdragon QCS615 SoC,
	  as well as the associated GPIO driver.

config SPL_PINCTRL_QCOM_QCS615
	bool "Qualcomm QCS615 Pinctrl in SPL"
	depends on SPL_PINCTRL_GENERIC
	select SPL_PINCTRL_QCOM
	help
	  SPL variant of PINCTRL_QCOM_QCS615.
	  See the help of PINCTRL_QCOM_QCS615 for details.

config PINCTRL_QCOM_QCS8300
	bool "Qualcomm QCS8300 Pinctrl"
	default y if PINCTRL_QCOM_GENERIC
	select PINCTRL_QCOM
	help
	  Say Y here to enable support for pinctrl on the Snapdragon QCS8300 SoC,
	  as well as the associated GPIO driver.

config SPL_PINCTRL_QCOM_QCS8300
	bool "Qualcomm QCS8300 Pinctrl in SPL"
	depends on SPL_PINCTRL_GENERIC
	select SPL_PINCTRL_QCOM
	help
	  SPL variant of PINCTRL_QCOM_QCS8300.
	  See the help of PINCTRL_QCOM_QCS8300 for details.

config PINCTRL_QCOM_SA8775P
	bool "Qualcomm SA8775P Pinctrl"
	default y if PINCTRL_QCOM_GENERIC
	select PINCTRL_QCOM
	help
	  Say Y here to enable support for pinctrl on the Snapdragon SA8775P SoC,
	  as well as the associated GPIO driver.

config SPL_PINCTRL_QCOM_SA8775P
	bool "Qualcomm SA8775P Pinctrl in SPL"
	depends on SPL_PINCTRL_GENERIC
	select SPL_PINCTRL_QCOM
	help
	  SPL variant of PINCTRL_QCOM_SA8775P.
	  See the help of PINCTRL_QCOM_SA8775P for details.

config PINCTRL_QCOM_SC7280
	bool "Qualcomm SC7280/QCM6490 Pinctrl"
	default y if PINCTRL_QCOM_GENERIC
	select PINCTRL_QCOM
	help
	  Say Y here to enable support for pinctrl on the Snapdragon SC7280 SoC,

config SPL_PINCTRL_QCOM_SC7280
	bool "Qualcomm SC7280/QCM6490 Pinctrl in SPL"
	depends on SPL_PINCTRL_GENERIC
	select SPL_PINCTRL_QCOM
	help
	  SPL variant of PINCTRL_QCOM_SC7280.
	  See the help of PINCTRL_QCOM_SC7280 for details.

config PINCTRL_QCOM_SDM670
	bool "Qualcomm SDM670 Pinctrl"
	default y if PINCTRL_QCOM_GENERIC
	select PINCTRL_QCOM
	help
	  Say Y here to enable support for pinctrl on the Snapdragon SDM670 SoC,
	  as well as the associated GPIO driver.

config SPL_PINCTRL_QCOM_SDM670
	bool "Qualcomm SDM670 Pinctrl in SPL"
	depends on SPL_PINCTRL_GENERIC
	select SPL_PINCTRL_QCOM
	help
	  SPL variant of PINCTRL_QCOM_SDM670.
	  See the help of PINCTRL_QCOM_SDM670 for details.

config PINCTRL_QCOM_SDM660
	bool "Qualcomm SDM630/660 Pinctrl"
	default y if PINCTRL_QCOM_GENERIC
	select PINCTRL_QCOM
	help
	  Say Y here to enable support for pinctrl on the Snapdragon 630/636/660
	  SoCs, as well as the associated GPIO driver.

config SPL_PINCTRL_QCOM_SDM660
	bool "Qualcomm SDM630/660 Pinctrl in SPL"
	depends on SPL_PINCTRL_GENERIC
	select SPL_PINCTRL_QCOM
	help
	  SPL variant of PINCTRL_QCOM_SDM660.
	  See the help of PINCTRL_QCOM_SDM660 for details.

config PINCTRL_QCOM_SDM845
	bool "Qualcomm SDM845 Pinctrl"
	default y if PINCTRL_QCOM_GENERIC
	select PINCTRL_QCOM
	help
	  Say Y here to enable support for pinctrl on the Snapdragon 845 SoC,
	  as well as the associated GPIO driver.

config SPL_PINCTRL_QCOM_SDM845
	bool "Qualcomm SDM845 Pinctrl in SPL"
	depends on SPL_PINCTRL_GENERIC
	select SPL_PINCTRL_QCOM
	help
	  SPL variant of PINCTRL_QCOM_SDM845.
	  See the help of PINCTRL_QCOM_SDM845 for details.

config PINCTRL_QCOM_SM6115
	bool "Qualcomm SM6115 Pinctrl"
	default y if PINCTRL_QCOM_GENERIC
	select PINCTRL_QCOM
	help
	  Say Y here to enable support for pinctrl on the Snapdragon SM6115 SoC,
	  as well as the associated GPIO driver.

config PINCTRL_QCOM_SM6125
	bool "Qualcomm SM6125 Pinctrl"
	default y if PINCTRL_QCOM_GENERIC
	select PINCTRL_QCOM
	help
	  Say Y here to enable support for pinctrl on the Snapdragon SM6125 SoC,
	  as well as the associated GPIO driver.

config SPL_PINCTRL_QCOM_SM6115
	bool "Qualcomm SM6115 Pinctrl in SPL"
	depends on SPL_PINCTRL_GENERIC
	select SPL_PINCTRL_QCOM
	help
	  SPL variant of PINCTRL_QCOM_SM6115.
	  See the help of PINCTRL_QCOM_SM6115 for details.

config PINCTRL_QCOM_SM6350
	bool "Qualcomm SM6350 Pinctrl"
	default y if PINCTRL_QCOM_GENERIC
	select PINCTRL_QCOM
	help
	  Say Y here to enable support for pinctrl on the Snapdragon SM6350 SoC,

config SPL_PINCTRL_QCOM_SM6350
	bool "Qualcomm SM6350 Pinctrl in SPL"
	depends on SPL_PINCTRL_GENERIC
	select SPL_PINCTRL_QCOM
	help
	  SPL variant of PINCTRL_QCOM_SM6350.
	  See the help of PINCTRL_QCOM_SM6350 for details.

config PINCTRL_QCOM_SM7150
	bool "Qualcomm SM7150 GCC"
	default y if PINCTRL_QCOM_GENERIC
	select PINCTRL_QCOM
	help
	  Say Y here to enable support for pinctrl on the Snapdragon SM7150 SoC,
	  as well as the associated GPIO driver.

config SPL_PINCTRL_QCOM_SM7150
	bool "Qualcomm SM7150 Pinctrl in SPL"
	depends on SPL_PINCTRL_GENERIC
	select SPL_PINCTRL_QCOM
	help
	  SPL variant of PINCTRL_QCOM_SM7150.
	  See the help of PINCTRL_QCOM_SM7150 for details.

config PINCTRL_QCOM_SM8150
	bool "Qualcomm SM8150 Pinctrl"
	default y if PINCTRL_QCOM_GENERIC
	select PINCTRL_QCOM
	help
	  Say Y here to enable support for pinctrl on the Snapdragon SM8150 SoC,
	  as well as the associated GPIO driver.

config SPL_PINCTRL_QCOM_SM8150
	bool "Qualcomm SM8150 Pinctrl in SPL"
	depends on SPL_PINCTRL_GENERIC
	select SPL_PINCTRL_QCOM
	help
	  SPL variant of PINCTRL_QCOM_SM8150.
	  See the help of PINCTRL_QCOM_SM8150 for details.

config PINCTRL_QCOM_SM8250
	bool "Qualcomm SM8250 Pinctrl"
	default y if PINCTRL_QCOM_GENERIC
	select PINCTRL_QCOM
	help
	  Say Y here to enable support for pinctrl on the Snapdragon SM8250 SoC,
	  as well as the associated GPIO driver.

config SPL_PINCTRL_QCOM_SM8250
	bool "Qualcomm SM8250 Pinctrl in SPL"
	depends on SPL_PINCTRL_GENERIC
	select SPL_PINCTRL_QCOM
	help
	  SPL variant of PINCTRL_QCOM_SM8250.
	  See the help of PINCTRL_QCOM_SM8250 for details.

config PINCTRL_QCOM_SM8550
	bool "Qualcomm SM8550 Pinctrl"
	default y if PINCTRL_QCOM_GENERIC
	select PINCTRL_QCOM
	help
	  Say Y here to enable support for pinctrl on the Snapdragon SM8550 SoC,
	  as well as the associated GPIO driver.

config SPL_PINCTRL_QCOM_SM8550
	bool "Qualcomm SM8550 Pinctrl in SPL"
	depends on SPL_PINCTRL_GENERIC
	select SPL_PINCTRL_QCOM
	help
	  SPL variant of PINCTRL_QCOM_SM8550.
	  See the help of PINCTRL_QCOM_SM8550 for details.

config PINCTRL_QCOM_SM8650
	bool "Qualcomm SM8650 Pinctrl"
	default y if PINCTRL_QCOM_GENERIC
	select PINCTRL_QCOM
	help
	  Say Y here to enable support for pinctrl on the Snapdragon SM8650 SoC,
	  as well as the associated GPIO driver.

config SPL_PINCTRL_QCOM_SM8650
	bool "Qualcomm SM8650 Pinctrl in SPL"
	depends on SPL_PINCTRL_GENERIC
	select SPL_PINCTRL_QCOM
	help
	  SPL variant of PINCTRL_QCOM_SM8650.
	  See the help of PINCTRL_QCOM_SM8650 for details.

config PINCTRL_QCOM_X1E80100
	bool "Qualcomm X1E80100 Pinctrl"
	default y if PINCTRL_QCOM_GENERIC
	select PINCTRL_QCOM
	help
	  Say Y here to enable support for pinctrl on the Snapdragon X1E80100 SoC,
	  as well as the associated GPIO driver.

config SPL_PINCTRL_QCOM_X1E80100
	bool "Qualcomm X1E80100 Pinctrl in SPL"
	depends on SPL_PINCTRL_GENERIC
	select SPL_PINCTRL_QCOM
	help
	  SPL variant of PINCTRL_QCOM_X1E80100.
	  See the help of PINCTRL_QCOM_X1E80100 for details.

endmenu

endif
```

## drivers/reboot-mode/Kconfig
```kconfig
#
# SPDX-License-Identifier: GPL-2.0+
#
# Copyright (c), Vaisala Oyj
#

menu "Reboot Mode Support"

config DM_REBOOT_MODE
	bool "Enable reboot mode using Driver Model"
	depends on DM
	select DEVRES
	help
	  Enable support for reboot mode control. This will allow users to
	  adjust the boot process based on reboot mode parameter
	  passed to U-Boot.

config DM_REBOOT_MODE_GPIO
	bool "Use GPIOs as reboot mode backend"
	depends on DM_REBOOT_MODE
	help
	  Use GPIOs to control the reboot mode. This will allow users to boot
	  a device in a specific mode by using a GPIO that can be controlled
	  outside U-Boot.

config DM_REBOOT_MODE_RTC
	bool "Use RTC as reboot mode backend"
	depends on DM_RTC
	depends on DM_REBOOT_MODE
	help
	  Use RTC non volatile memory to control the reboot mode. This will allow users to boot
	  a device in a specific mode by using a register(s) that can be controlled
	  outside U-Boot (e.g. Kernel).

config REBOOT_MODE_NVMEM
	bool "Use NVMEM reboot mode"
	depends on DM_REBOOT_MODE && NVMEM
	help
	  Use any kind of non-volatile memory (EEPROM, RTC, etc) to control the
	  reboot mode.

config REBOOT_MODE_ENV_UPDATE
	bool "Automatically update reboot-mode env variable on boot"
	depends on DM_REBOOT_MODE
	help
	  When enabled, the reboot-mode uclass will automatically call
	  dm_reboot_mode_update() on the first reboot-mode device at last
	  stage init.

config REBOOT_MODE_PSCI
	bool "Use PSCI SYSTEM_RESET2 vendor resets as reboot modes"
	depends on DM_REBOOT_MODE && ARM_SMCCC
	help
	  Trigger PSCI SYSTEM_RESET2 vendor-specific resets (for example
	  rebooting a Qualcomm SoC into EDL/download mode) via the reboot-mode
	  framework. Each reset is described by a "mode-*" property under the
	  "reboot-mode" subnode of the psci device tree node, so the magic
	  values are not hard-coded in the driver. The modes can then be
	  triggered from the "reset" command by name.

endmenu
```
