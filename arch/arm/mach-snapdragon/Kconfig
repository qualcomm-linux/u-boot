## configs/qcom_lemans_snagboot_defconfig
```kconfig
# Configuration for building U-Boot for snagboot/recovery mode
# on Lemans-EVK dev boards.
#
# For normal production boot, use qcom_lemans_defconfig instead.

#include "qcom_defconfig"
#include "qcom-snagboot.config"

# Platform-specific settings for Lemans-EVK

# Address where U-Boot will be loaded
CONFIG_TEXT_BASE=0x1c100000
CONFIG_REMAKE_ELF=y
CONFIG_FASTBOOT_BUF_ADDR=0xdb300000
CONFIG_DEFAULT_DEVICE_TREE="qcom/lemans-evk"

# Timer frequency for Lemans platform
CONFIG_COUNTER_FREQUENCY=19200000

CONFIG_OF_UPSTREAM=y

CONFIG_QCOM_COMMAND_DB=y

CONFIG_IOMMU=y
CONFIG_QCOM_HYP_SMMU=y

CONFIG_SPI=y
CONFIG_DM_SPI=y
CONFIG_SPI_GENI_QCOM=y
CONFIG_MTD=y
CONFIG_DM_MTD=y
CONFIG_CMD_MTD=y
CONFIG_MTD_BLOCK=y
CONFIG_DM_SPI_FLASH=y
CONFIG_SPI_FLASH_MTD=y
CONFIG_SPI_FLASH_SFDP_SUPPORT=y
CONFIG_SF_DEFAULT_BUS=0
CONFIG_SF_DEFAULT_CS=0
CONFIG_SF_DEFAULT_SPEED=48000000
CONFIG_SF_DEFAULT_MODE=0
CONFIG_CMD_SF_TEST=y

CONFIG_SPI_FLASH_ATMEL=y
CONFIG_SPI_FLASH_DOSILICON=y
CONFIG_SPI_FLASH_EON=y
CONFIG_SPI_FLASH_GIGADEVICE=y
CONFIG_SPI_FLASH_ISSI=y
CONFIG_SPI_FLASH_MACRONIX=y
CONFIG_SPI_FLASH_PUYA=y
CONFIG_SPI_FLASH_SILICONKAISER=y
CONFIG_SPI_FLASH_SPANSION=y
CONFIG_SPI_FLASH_STMICRO=y
CONFIG_SPI_FLASH_SST=y
CONFIG_SPI_FLASH_WINBOND=y
CONFIG_SPI_FLASH_XMC=y
CONFIG_SPI_FLASH_XTX=y
CONFIG_SPI_FLASH_ZBIT=y

CONFIG_FASTBOOT_OEM_RUN=y
CONFIG_QCOM_SNAGBOOT_SPI_NOR_FIXUP=y
```

## configs/qcom_lemans_spl_defconfig
```kconfig
# Configuration for building U-Boot to be flashed
# to the uefi partition of Lemans-EVK dev boards with
# the "Linux Embedded" partition layout (which have
# a dedicated "uefi" partition for edk2/U-Boot)

#include "qcom_defconfig"

CONFIG_FASTBOOT_BUF_ADDR=0xdb300000
CONFIG_DEFAULT_DEVICE_TREE="qcom/lemans-evk"
CONFIG_ENV_IS_IN_SCSI=y
CONFIG_ENV_SCSI_PART_USE_TYPE_GUID=y
# SCSI partition type GUID for logfs partition
CONFIG_ENV_SCSI_PART_TYPE_GUID="bc0330eb-3410-4951-a617-03898dbe3372"
# CONFIG_ENV_IS_DEFAULT is not set
# CONFIG_ENV_IS_NOWHERE is not set

# SPL configurations for Lemans-EVK
# Purpose: Load FIT image (containing TFA, OPTEE and U-Boot proper)
# from UFS storage and jump to next image (TFA)

CONFIG_SPL=y
CONFIG_SPL_BUILD=y
CONFIG_SPL_FRAMEWORK=y

CONFIG_SPL_TEXT_BASE=0x1c100000
CONFIG_SPL_MAX_SIZE=0x60000
CONFIG_SPL_BSS_LIMIT=y
CONFIG_SPL_BSS_MAX_SIZE=0x10000
# CONFIG_SPL_SEPARATE_BSS is not set

# CONFIG_SPL_SHARES_INIT_SP_ADDR is not set
CONFIG_SPL_HAVE_INIT_STACK=y
CONFIG_SPL_STACK=0xD7300000

CONFIG_SPL_SYS_MALLOC_F_LEN=0x80000
CONFIG_SPL_SYS_MALLOC=y
CONFIG_SPL_HAS_CUSTOM_MALLOC_START=y
CONFIG_SPL_CUSTOM_SYS_MALLOC_ADDR=0xdb300000
CONFIG_SPL_SYS_MALLOC_SIZE=0x10000

CONFIG_SPL_LIBCOMMON_SUPPORT=y
CONFIG_SPL_LIBGENERIC_SUPPORT=y

CONFIG_SPL_DM=y
CONFIG_SPL_OF_LIBFDT=y
CONFIG_SPL_OF_CONTROL=y
CONFIG_SPL_OF_REAL=y
CONFIG_SPL_SIMPLE_BUS=y

CONFIG_SPL_DM_RESET=y

CONFIG_SPL_CLK=y

CONFIG_SPL_GPIO=y
CONFIG_SPL_DM_GPIO=y

CONFIG_SPL_UFS=y
CONFIG_SPL_UFS_QCOM=y

CONFIG_SPL_UFS_RAW_U_BOOT_DEVNUM=4
CONFIG_SPL_UFS_RAW_U_BOOT_SECTOR=0x0
CONFIG_SPL_UFS_RAW_U_BOOT_USE_PARTITION=y
CONFIG_SPL_UFS_RAW_U_BOOT_PARTITION_NAME="uefi_a"
CONFIG_SPL_UFS_RAW_U_BOOT_PARTITION_NUM=1

CONFIG_SPL_PARTITIONS=y
CONFIG_SPL_DOS_PARTITION=y
CONFIG_SPL_CHARSET=y

CONFIG_SPL_PHY=y
CONFIG_SPL_PHY_QCOM_QMP_UFS=y

CONFIG_SPL_POWER=y
CONFIG_SPL_POWER_DOMAIN=y

CONFIG_SPL_LOAD_FIT=y

CONFIG_SPL_ATF=y

CONFIG_SPL_REMAKE_ELF=y

CONFIG_COUNTER_FREQUENCY=19200000

# CONFIG_SAVE_PREV_BL_FDT_ADDR is not set
# CONFIG_SAVE_PREV_BL_INITRAMFS_START_ADDR is not set
CONFIG_SPL_ATF_LOAD_IMAGE_V2=y
CONFIG_SPL_ATF_NO_PLATFORM_PARAM=y
CONFIG_SPL_HAS_LOAD_FIT_ADDRESS=y
CONFIG_SPL_LOAD_FIT_ADDRESS=0xB0800000
CONFIG_SPL_FRAMEWORK_BOARD_INIT_F=y

CONFIG_SPL_DRIVERS_MISC=y
CONFIG_SPL_SERIAL=y
CONFIG_SPL_MISC=y
CONFIG_SPL_QCOM_GENI=y
CONFIG_SPL_MSM_GENI_SERIAL=y

CONFIG_SPL_BANNER_PRINT=y
CONFIG_SPL_CLK_STUB=y
CONFIG_SPL_PINCTRL=y
CONFIG_SPL_PINCTRL_QCOM_SA8775P=y
CONFIG_SPL_QCOM_SMEM=y
# CONFIG_SPL_QCOM_BOOT_FROM_PBL is not set
```

## configs/qcom_shikra_spl_defconfig
```kconfig
# SPDX-License-Identifier: GPL-2.0-only

#include "qcom_shikra_defconfig"

# CONFIG_DEBUG_UART is not set

CONFIG_DEFAULT_DEVICE_TREE="shikra-cqs-evk"

CONFIG_SYS_PBSIZE=1024

CONFIG_SPL=y
CONFIG_SPL_FRAMEWORK=y
CONFIG_SPL_OF_CONTROL=y
CONFIG_SPL_LIBGENERIC_SUPPORT=y
CONFIG_SPL_LIBCOMMON_SUPPORT=y
CONFIG_SPL_OF_LIBFDT=y
CONFIG_SPL_DM=y
CONFIG_SPL_GPIO=y
CONFIG_SPL_DM_GPIO=y
CONFIG_SPL_DM_REGULATOR=y
CONFIG_SPL_DM_RESET=y
CONFIG_SPL_POWER_DOMAIN=y
CONFIG_SPL_PINCTRL=y
CONFIG_SPL_PINCTRL_GENERIC=y
CONFIG_SPL_PINCTRL_QCOM=y
CONFIG_SPL_PINCTRL_QCOM_SHIKRA=y
CONFIG_SPL_CLK=y
CONFIG_SPL_CLK_STUB=y
CONFIG_SPL_CLK_QCOM_SHIKRA=y
CONFIG_SPL_DRIVERS_MISC=y
CONFIG_SPL_DRIVERS_MISC_SUPPORT=y
CONFIG_SPL_QCOM_GENI=y
CONFIG_SPL_SERIAL=y
CONFIG_SPL_MSM_GENI_SERIAL=y
CONFIG_SPL_SMEM=y
CONFIG_DM_STATS=y
CONFIG_SPL_SYS_MALLOC_F=y
CONFIG_SPL_SYS_MALLOC_F_LEN=0x38000
CONFIG_SPL_SYS_MALLOC=y
CONFIG_SYS_MALLOC_DEFAULT_TO_INIT=y
CONFIG_SPL_HAS_CUSTOM_MALLOC_START=y
CONFIG_SPL_CUSTOM_SYS_MALLOC_ADDR=0x80008000
CONFIG_SPL_SYS_MALLOC_SIZE=0x20000
# CONFIG_SPL_SEPARATE_BSS is not set
# CONFIG_SPL_USE_TINY_PRINTF is not set
CONFIG_SPL_BSS_MAX_SIZE=0x4000
CONFIG_SPL_TEXT_BASE=0x0C219000
CONFIG_SPL_MAX_SIZE=0x7B800
CONFIG_SPL_MMC=y
CONFIG_SPL_MMC_SDHCI_ADMA=y
CONFIG_SPL_MMC_WRITE=y
CONFIG_SPL_SYS_MMCSD_RAW_MODE=y
CONFIG_SYS_MMCSD_RAW_MODE_U_BOOT_USE_PARTITION=y
CONFIG_SYS_MMCSD_RAW_MODE_U_BOOT_PARTITION=0x00
CONFIG_COUNTER_FREQUENCY=24000000
CONFIG_SPL_STACKPROTECTOR=y
CONFIG_SPL_LOAD_FIT=y
CONFIG_SPL_ATF=y
CONFIG_SPL_ATF_LOAD_IMAGE_V2=y
CONFIG_SPL_ATF_NO_PLATFORM_PARAM=y
CONFIG_SPL_HAS_LOAD_FIT_ADDRESS=y
CONFIG_SPL_LOAD_FIT_ADDRESS=0x0C2C1800
# CONFIG_SPL_SHARES_INIT_SP_ADDR is not set
CONFIG_SPL_HAVE_INIT_STACK=y
CONFIG_SPL_STACK=0x0C294800
# CONFIG_SAVE_PREV_BL_FDT_ADDR is not set
# CONFIG_SAVE_PREV_BL_INITRAMFS_START_ADDR is not set
CONFIG_SPL_REMAKE_ELF=y
CONFIG_SPL_REMAKE_ELF_LDSCRIPT="board/qualcomm/shikra/shikra-spl-wrap-elf.lds"
CONFIG_QCOM_XBL_SEC_ELF="qc_sec.mbn"
CONFIG_QCOM_SPL_BOOTIMEM_FLUSH_BASE=0x0C219000
CONFIG_QCOM_SPL_BOOTIMEM_FLUSH_SIZE=0x134000
CONFIG_SYS_BOARD="shikra"
```
