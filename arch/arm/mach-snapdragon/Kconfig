## arch/arm/mach-snapdragon/Kconfig
```kconfig
if ARCH_SNAPDRAGON

config SYS_SOC
	default "snapdragon"

config SYS_VENDOR
	string "Snapdragon board vendor"
	default "qualcomm"
	help
	  Allows to specify vendor for the Snapdragon SoCs based boards.
	  Based on this option board/<CONFIG_SYS_VENDOR>/<CONFIG_SYS_BOARD>
	  will be used as the custom board directory.

config SYS_MALLOC_F_LEN
	default 0x2000

config SPL_SYS_MALLOC_F
	default y

config SPL_SYS_MALLOC_F_LEN
	default 0x2000

config LNX_KRNL_IMG_TEXT_OFFSET_BASE
	default 0x80000000

config SPL_SHARES_INIT_SP_ADDR
	# override the default from common/spl/Kconfig
	default n

config SPL_HAVE_INIT_STACK
	default y

config SYS_BOARD
	string "Snapdragon SoCs based board"
	help
	  Allows to specify the Snapdragon SoCs based board name.
	  Based on this option board/<CONFIG_SYS_VENDOR>/<CONFIG_SYS_BOARD>
	  will be used as the custom board directory.

config SYS_CONFIG_NAME
	string "Board configuration name"
	default SYS_BOARD if SYS_BOARD != ""
	default "qcom"
	help
	  This option contains information about board configuration name.
	  Based on this option include/configs/<CONFIG_SYS_CONFIG_NAME>.h header
	  will be used for board configuration.

config QCOM_FIT_MULTIDTB
	bool "Enable FIT multi-DTB selection for Qualcomm platforms"
	depends on FIT
	select QCOM_HWDETECT
	help
	  Enable FIT multi-DTB selection for Qualcomm platforms.
	  This allows U-Boot to select the appropriate device tree
	  from a FIT image.

config QCOM_HWDETECT
	bool "Qualcomm Hardware Detection"
	depends on QCOM_SMEM
	select QCOM_HWINFO
	help
	  Hardware parameter detection from SMEM and TCSR for
	  DTB selection and other platform subsystems.

config QCOM_SPL_CDT_SUPPORTED
	bool "Enable CDT support in SPL"
	depends on SPL
	help
	  Enable support for reading the CDT off the boot medium during
	  SPL and staging it in IMEM, so that QCLIB can pick it up via
	  the interface table.

if QCOM_SPL_CDT_SUPPORTED

choice
	prompt "CDT partition lookup method"
	default QCOM_SPL_CDT_USE_PARTITION_NAME

config QCOM_SPL_CDT_USE_PARTITION_NAME
	bool "Look up the CDT partition by GPT partition name"
	depends on SPL_PARTITIONS
	help
	  Locate the CDT partition on the boot medium by its GPT partition
	  name (CONFIG_QCOM_SPL_CDT_PARTITION_NAME).

config QCOM_SPL_CDT_USE_PARTITION_GUID
	bool "Look up the CDT partition by GPT partition type GUID"
	depends on SPL_PARTITION_TYPE_GUID
	help
	  Locate the CDT partition on the boot medium by its GPT partition
	  type GUID (CONFIG_QCOM_SPL_CDT_PARTITION_GUID).

endchoice

config QCOM_SPL_CDT_PARTITION_NAME
	string "CDT GPT partition name"
	depends on QCOM_SPL_CDT_USE_PARTITION_NAME
	default "cdt"
	help
	  Name of the GPT partition on the boot medium containing the CDT
	  (Config/Chip Data Table) data.

config QCOM_SPL_CDT_PARTITION_GUID
	string "CDT GPT partition type GUID"
	depends on QCOM_SPL_CDT_USE_PARTITION_GUID
	help
	  GPT partition type GUID identifying the CDT (Config/Chip Data
	  Table) partition on the boot medium.

config QCOM_SPL_CDT_MMC_PARTITION_NUM
	int "eMMC hardware partition containing the CDT partition"
	default 0
	help
	  eMMC hardware partition number (0 = default user data area) on
	  which the CDT GPT partition is located. Ignored for non-MMC boot
	  media.

config QCOM_SPL_BOOTIMEM_CDT_BASE
	hex "IMEM address to stage the CDT contents at"
	help
	  Address within BOOTIMEM where the CDT contents read from the boot
	  medium are staged, to be consumed by QCLIB via the interface
	  table.

config QCOM_SPL_BOOTITEM_CDT_SIZE
	hex "Maximum number of bytes to stage for the CDT"
	default 0x200
	help
	  Maximum number of bytes read from the CDT partition and staged at
	  CONFIG_QCOM_SPL_BOOTIMEM_CDT_BASE.

endif # QCOM_SPL_CDT_SUPPORTED

choice
	prompt "Qualcomm boot0.h workaround"
	optional
	help
	  While U-Boot on Qualcomm platforms doesn't generally need compile-time
	  adjustments based on the target SoC, workarounds in boot0.h can't
	  practically detect the SoC at runtime. Enable one of these workarounds
	  if you know you need it.

config BOOT0_MSM8916_PSCI_WORKAROUND
	bool "boot0.h workaround for buggy PSCI on the msm8916 SoC"
	help
	  Select this if you are building U-Boot proper for an msm8916 board that
	  uses the buggy PSCI implementation.

config QCOM_EL2_GUNYAH_EXIT_SUPPORT
	bool "Enable early EL2 switch by exiting Gunyah"
	help
	  Exit Gunyah hypervisor and switch to EL2 during early boot. This must
	  happen before EL register configuration in start.S so that U-Boot can
	  run properly at EL2.

endchoice

config QCOM_BOOT0_SNAGBOOT_MODE
	bool "boot0.h initialization for Snagboot mode"
	help
	  Enable boot0.h early initialization required when U-Boot
	  is loaded in Snagboot mode by XBL.

config QCOM_SNAGBOOT_MODE
	bool "Build U-Boot for Snagboot mode loading"
	select QCOM_BOOT0_SNAGBOOT_MODE
	select ENABLE_ARM_SOC_BOOT0_HOOK
	select SKIP_RELOCATE
	help
	  Build U-Boot to be loaded in Snagboot mode on Qualcomm platforms
	  for device/factory provisioning using fastboot.

	  Snagboot mode requires disabling several configs in your defconfig:
	  - PSCI_RESET: Not available in Snagboot mode
	  - IOMMU: Not initialized by XBL in Snagboot mode
	  - SAVE_PREV_BL_INITRAMFS_START_ADDR: Previous bootloader context
	    is not preserved in snagboot mode
	  - REBOOT_MODE_ENV_UPDATE: Not applicable in device/factory provisioning mode

	  Additionally, use CONFIG_ENV_IS_NOWHERE to ensure recovery works
	  even with corrupted environment storage.

	  Platform-specific requirements:
	  - Set CONFIG_COUNTER_FREQUENCY to match your platform's timer
	  - Configure CONFIG_TEXT_BASE for U-Boot load address

config QCOM_SNAGBOOT_SPI_NOR_FIXUP
	bool "Enable spi0-aliased SPI-NOR node for Snagboot mode"
	depends on QCOM_SNAGBOOT_MODE
	select OF_BOARD_FIXUP
	help
	  Enable the SPI-NOR flash node referenced by the "spi0" alias (and
	  its parent bus node) when booting in Snagboot mode. Boards that
	  use a different medium for Snagboot provisioning should leave
	  this disabled.

config QCOM_GENERATE_MBN
	bool "Generate an MBN-compatible ELF binary"
	help
	  Enable this if you intend to flash U-Boot as a first-stage bootloader.
	  The build system will generate a board-specific ELF file with the appropriate
	  MBN hash segments and test keys.

	  New platforms can be added to tools/qcom/mkmbn/mkmbn.py if they aren't already
	  supported.

config QCOM_TMEL_ELF
	string "TME Elf to concatenate with U-Boot SPL MBN image"
	depends on SPL && QCOM_GENERATE_MBN
	help
	  Path of the TME Elf file to be concatenated to u-boot.mbn to create
	  boot rom expected multi-elf image

config QCOM_XBL_SEC_ELF
	string "XBL-sec ELF image"
	depends on SPL && SPL_REMAKE_ELF
	help
	  Name of the XBL-sec ELF image in the U-Boot source-tree root to
	  embed in the SPL ELF.

	  The image is copied to the build output as xbl_sec.elf and embedded
	  by the platform SPL linker script as a Qualcomm XBL-sec segment.

choice
	prompt "Qualcomm boot0.h workaround"
	optional
	help
	  While U-Boot on Qualcomm platforms doesn't generally need compile-time
	  adjustments based on the target SoC, workarounds in boot0.h can't
	  practically detect the SoC at runtime. Enable one of these workarounds
	  if you know you need it.

config BOOT0_MSM8916_PSCI_WORKAROUND
	bool "boot0.h workaround for buggy PSCI on the msm8916 SoC"
	help
	  Select this if you are building U-Boot proper for an msm8916 board that
	  uses the buggy PSCI implementation.

config BOOT0_SDM845_WORKAROUND
	bool "boot0.h workaround for SPL on the sdm845 SoC"
	depends on SPL
	help
	  Select this if you are building U-Boot SPL for sdm845.

endchoice

endif
```

## board/qualcomm/fit_spl.its
```
/*
 * ==========================================================================
 * Copyright (c) Qualcomm Technologies, Inc. and/or its subsidiaries.
 * SPDX-License-Identifier: ISC
 * ==========================================================================
 */

/dts-v1/;

/ {
    description = "FIT Image for SPL";
    #address-cells = <1>;

    images {

        /* ------------------------ */
        /*  QC Config Segments      */
        /* ------------------------ */
        qcconfig_1 {
            description = "qcconfig1";
            data = /incbin/("./qcconfig_1_load_segment.bin");
            type = "firmware";
            arch = "arm64";
            os = "elf";
            load = <QCCONFIG_1_LOAD_ADDR>;
            entry = <QCCONFIG_ENTRY_ADDR>;
            compression = "none";
        };

        qcconfig_2 {
            description = "qcconfig2";
            data = /incbin/("./qcconfig_2_load_segment.bin");
            type = "firmware";
            arch = "arm64";
            load = <QCCONFIG_2_LOAD_ADDR>;
            compression = "none";
        };

        qcconfig_3 {
            description = "qcconfig3";
            data = /incbin/("./qcconfig_3_load_segment.bin");
            type = "firmware";
            arch = "arm64";
            load = <QCCONFIG_3_LOAD_ADDR>;
            compression = "none";
        };

        qcconfig_4 {
            description = "qcconfig4";
            data = /incbin/("./qcconfig_4_load_segment.bin");
            type = "firmware";
            arch = "arm64";
            load = <QCCONFIG_4_LOAD_ADDR>;
            compression = "none";
        };

        qcconfig-meta {
            description = "qcconfig meta";
            data = /incbin/("./qcconfig_meta_segments.bin");
            type = "firmware";
            arch = "arm64";
            load = <META_LOAD_ADDR>;
            entry = <QCCONFIG_ENTRY_ADDR>;
            compression = "none";
        };

        /* ------------------------ */
        /*  QC Lib Segments         */
        /* ------------------------ */
        qclib_1 {
            description = "qclib1";
            data = /incbin/("./qclib_1_load_segment.bin");
            type = "firmware";
            arch = "arm64";
            os = "elf";
            load = <QCLIB_1_LOAD_ADDR>;
            entry = <QCLIB_ENTRY_ADDR>;
            compression = "none";
        };

        qclib_2 {
            description = "qclib2";
            data = /incbin/("./qclib_2_load_segment.bin");
            type = "firmware";
            arch = "arm64";
            load = <QCLIB_2_LOAD_ADDR>;
            compression = "none";
        };

        qclib-meta {
            description = "qclib meta";
            data = /incbin/("./qclib_meta_segments.bin");
            type = "firmware";
            arch = "arm64";
            load = <META_LOAD_ADDR>;
            entry = <QCLIB_ENTRY_ADDR>;
            compression = "none";
        };

        /* ------------------------ */
        /*  BL31 (ARM Trusted FW)   */
        /* ------------------------ */
        tfa {
            description = "ARM Trusted Firmware";
            data = /incbin/("bl31.bin");
            type = "firmware";
            arch = "arm64";
            os = "arm-trusted-firmware";
            compression = "none";
            load = <0x1c200000>;
            entry = <0x1c200000>;

            hash-1 {
                algo = "sha256";
            };
        };

        /* ------------------------ */
        /*  BL32 (OP-TEE)           */
        /* ------------------------ */
        optee {
            description = "OP-TEE Secure OS";
            data = /incbin/("bl32.bin");
            type = "tee";
            arch = "arm64";
            os = "tee";
            compression = "none";
            load = <0x1c300000>;
            entry = <0x1c300000>;

            hash-1 {
                algo = "sha256";
            };
        };

        /* ------------------------ */
        /*  BL33 (U-Boot)           */
        /* ------------------------ */
        uboot {
            description = "U-Boot Bootloader";
            data = /incbin/("bl33.bin");
            type = "standalone";
            arch = "arm64";
            os = "u-boot";
            compression = "none";
            load = <0xaf400000>;
            entry = <0xaf400000>;

            hash-1 {
                algo = "sha256";
            };
        };
    };

    /* ---------------------------- */
    /*  CONFIGURATION               */
    /* ---------------------------- */
    configurations {
        default = "post-ddr";
        pre-ddr-config {
            description = "pre-ddr";
            loadables =
            "qcconfig_1", "qcconfig_2", "qcconfig_3", "qcconfig_4", "qcconfig-meta",
            "qclib_1", "qclib_2", "qclib-meta"
            ;
        };
        post-ddr-config {
            description = "post-ddr";
            loadables = "tfa", "uboot", "optee";
        };
    };
};
```

## configs/qcom_ipq5210_mmc_defconfig
```kconfig
CONFIG_ARM=y
CONFIG_SKIP_LOWLEVEL_INIT=y
CONFIG_POSITION_INDEPENDENT=y
CONFIG_SYS_INIT_SP_BSS_OFFSET=0x180000
CONFIG_ARCH_SNAPDRAGON=y
CONFIG_TEXT_BASE=0x87980000
CONFIG_NR_DRAM_BANKS=2
CONFIG_ENV_SIZE=0x40000
CONFIG_ENV_OFFSET=0
CONFIG_DEFAULT_DEVICE_TREE="qcom/ipq5210-rdp504"
CONFIG_SYS_LOAD_ADDR=0x90000000
CONFIG_REMAKE_ELF=y
CONFIG_FIT=y
CONFIG_FIT_VERBOSE=y
# CONFIG_BOOTSTD is not set
CONFIG_OF_BOARD_SETUP=y
CONFIG_USE_PREBOOT=y
CONFIG_SYS_PBSIZE=1024
# CONFIG_DISPLAY_CPUINFO is not set
CONFIG_DISPLAY_BOARDINFO_LATE=y
CONFIG_HUSH_PARSER=y
CONFIG_CMD_MMC=y
CONFIG_CMD_PART=y
CONFIG_EFI_PARTITION=y
CONFIG_OF_LIVE=y
CONFIG_ENV_IS_IN_MMC=y
CONFIG_CLK=y
CONFIG_CLK_QCOM_IPQ5210=y
CONFIG_MSM_GPIO=y
# CONFIG_I2C is not set
# CONFIG_INPUT is not set
CONFIG_MISC=y
CONFIG_QCOM_GENI=y
CONFIG_QCOM_GENI_MINICORE=y
CONFIG_MMC_HS200_SUPPORT=y
CONFIG_MMC_SDHCI=y
# CONFIG_MMC_SDHCI_ADMA_HELPERS is not set
# CONFIG_MMC_SDHCI_ADMA is not set
# CONFIG_MMC_SDHCI_ADMA_FORCE_32BIT is not set
# CONFIG_MMC_SDHCI_ADMA_64BIT is not set
CONFIG_MMC_SDHCI_MSM=y
CONFIG_MTD=y
CONFIG_DM_MDIO=y
CONFIG_DM_ETH_PHY=y
CONFIG_DWC_ETH_QOS=y
CONFIG_DWC_ETH_QOS_QCOM=y
CONFIG_RGMII=y
CONFIG_PHY=y
CONFIG_PHY_QCOM_QMP_UFS=y
CONFIG_PHY_QCOM_QUSB2=y
CONFIG_PINCTRL=y
CONFIG_PINCONF=y
CONFIG_PINCTRL_QCOM_IPQ5210=y
CONFIG_DEBUG_UART_MSM_GENI=y
CONFIG_DEBUG_UART_ANNOUNCE=y
CONFIG_MSM_SERIAL=y
CONFIG_MSM_GENI_SERIAL=y
CONFIG_SOC_QCOM=y
CONFIG_SPL=y
CONFIG_SPL_FRAMEWORK=y
CONFIG_SPL_OF_CONTROL=y
CONFIG_SPL_LIBGENERIC_SUPPORT=y
CONFIG_SPL_LIBCOMMON_SUPPORT=y
CONFIG_SPL_OF_LIBFDT=y
CONFIG_SPL_DM=y
CONFIG_SPL_GPIO=y
CONFIG_SPL_DM_GPIO=y
CONFIG_SPL_DM_RESET=y
CONFIG_SPL_PINCTRL=y
CONFIG_SPL_CLK=y
CONFIG_SPL_DRIVERS_MISC=y
CONFIG_SPL_DRIVERS_MISC_SUPPORT=y
CONFIG_SPL_SERIAL=y
CONFIG_SPL_SMEM=y
CONFIG_DM_STATS=y
CONFIG_SPL_SYS_MALLOC_F=y
CONFIG_SPL_SYS_MALLOC_F_LEN=0x20000
CONFIG_SPL_SYS_MALLOC=y
CONFIG_SYS_MALLOC_DEFAULT_TO_INIT=y
CONFIG_SPL_HAS_CUSTOM_MALLOC_START=y
CONFIG_SPL_CUSTOM_SYS_MALLOC_ADDR=0x80008000
CONFIG_SPL_SYS_MALLOC_SIZE=0x20000
# CONFIG_SPL_SEPARATE_BSS is not set
# CONFIG_SPL_USE_TINY_PRINTF is not set
CONFIG_SPL_BSS_MAX_SIZE=0x4000
CONFIG_SPL_TEXT_BASE=0x08c24000
CONFIG_SPL_MAX_SIZE=0x3D000
CONFIG_SPL_MMC=y
CONFIG_SPL_MMC_SDHCI_ADMA=y
CONFIG_SPL_MMC_WRITE=y
CONFIG_SPL_SYS_MMCSD_RAW_MODE=y
CONFIG_SYS_MMCSD_RAW_MODE_U_BOOT_USE_PARTITION=y
CONFIG_SYS_MMCSD_RAW_MODE_U_BOOT_PARTITION=0x00
CONFIG_COUNTER_FREQUENCY=24000000
CONFIG_SPL_STACKPROTECTOR=y
CONFIG_SPL_LOAD_FIT=y
CONFIG_SPL_ATF=y
CONFIG_SPL_ATF_LOAD_IMAGE_V2=y
CONFIG_SPL_ATF_NO_PLATFORM_PARAM=y
CONFIG_SPL_HAS_LOAD_FIT_ADDRESS=y
CONFIG_SPL_LOAD_FIT_ADDRESS=0x08cbe000
# CONFIG_SPL_SHARES_INIT_SP_ADDR is not set
CONFIG_SPL_HAVE_INIT_STACK=y
CONFIG_SPL_STACK=0x08c24000
# CONFIG_SAVE_PREV_BL_FDT_ADDR is not set
CONFIG_SPL_WRAPPER_ELF=y
```
