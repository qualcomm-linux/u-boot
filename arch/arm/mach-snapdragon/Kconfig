## drivers/soc/qcom/Kconfig
```kconfig
# SPDX-License-Identifier: GPL-2.0-only
#
# QCOM Soc drivers
#
menuconfig SOC_QCOM
	bool "Qualcomm SOC drivers support"
	depends on ARM64
	help
	  Say Y here if you want to enable Qualcomm SOC drivers support.

if SOC_QCOM

config QCOM_COMMAND_DB
	bool "Qualcomm Command DB"
	help
	  Command DB queries shared memory by key string for shared system
	  resources. Platform drivers that require to set state of a shared
	  resource on a RPM-hardened platform must use this database to get
	  SoC specific identifier and information for the shared resources.

config QCOM_COMMAND_DB_OPTIONAL
	bool "Allow operation without Command DB data"
	depends on QCOM_COMMAND_DB
	help
	  Allow the Command DB driver to bind successfully even when CMD DB
	  data is not populated or has an invalid magic number.

	  This is useful for platforms where CMD DB is not populated by the
	  previous bootloader (e.g., snagboot mode where XBL loads U-Boot
	  directly without initializing CMD DB).

	  When enabled, missing CMD DB will generate warnings but allow boot
	  to continue. Consumer drivers must handle cmd_db API failures
	  gracefully by checking return values.

	  If unsure, say N. Most production Qualcomm platforms require
	  valid CMD DB data.

config QCOM_RPMH
	bool "Qualcomm RPMh support"
	depends on QCOM_COMMAND_DB
	help
	  Say y here to support the Qualcomm RPMh (resource peripheral manager)
	  if you need to control regulators on Qualcomm platforms, say y here.

config QCOM_SMEM
	bool "Qualcomm SMEM support"
	help
	  Say y here to support the Qualcomm SMEM (shared memory) client driver.
	  SMEM is a shared memory region that is used to pass information about
	  the hardware (e.g. DRAM layout, PMIC configuration, etc) between bootloader
	  staged and the OS. If in doubt, say y.

config SPL_QCOM_SMEM
	bool "Qualcomm SMEM support in SPL"
	help
	  Say y here to support the Qualcomm SMEM (shared memory) client driver in SPL.
	  SMEM is a shared memory region that is used to pass information about
	  the hardware (e.g. DRAM layout, PMIC configuration, etc) between bootloader
	  staged and the OS. If in doubt, say y.
endif # SOC_QCOM
```
