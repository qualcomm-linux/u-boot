## drivers/usb/tcpm/Kconfig
```kconfig
# SPDX-License-Identifier: GPL-2.0

config TYPEC_TCPM
	bool "USB Type-C Port Controller Manager"
	depends on DM
	help
	  The Type-C Port Controller Manager provides a USB PD and USB Type-C
	  state machine for use with Type-C Port Controllers.

config TYPEC_FUSB302
	bool "Fairchild FUSB302 Type-C chip driver"
	depends on DM && DM_I2C && TYPEC_TCPM
	help
	  The Fairchild FUSB302 Type-C chip driver that works with
	  Type-C Port Controller Manager to provide USB PD and USB
	  Type-C functionalities.

config TYPEC_QCOM_PMIC
	bool "Qualcomm PMIC Type-C port driver"
	depends on DM_PMIC && DM_REGULATOR && TYPEC_TCPM
	help
	  Driver for the Type-C port block of Qualcomm PMICs such as the
	  PMI632 and PM4125. It provides Type-C attach detection and VBUS
	  control for the TCPM. USB Power Delivery is not supported.
```
